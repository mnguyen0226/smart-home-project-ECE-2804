/**
* Author: Minh Nguyen
* 6/9/2020
* Ultimate Merge for
* Intruder Detection System
* Weather Station + AC Unit
* Automated Night Light
* Fire Alarm System
* Indoor Light
*/
//////////////////////////////////////////////////////////////////////////////////////////////////////////////////////////////////
#include <LiquidCrystal.h>
#include <SoftwareSerial.h>
#include <Arduino.h>
#include "Talkie.h"
#include "Vocab_US_Large.h"
#include <PCM.h>

/**---------------------------------------------------------------------------------------
 * Initialization for Intruder Detection System
 */
//Initialize the library by associating lCD interface pin with the arduino pin number
const int rs = 13, en = 12, d4 = 7, d5 = 6, d6 = 5, d7 = 4;
LiquidCrystal lcd(rs,en, d4, d5, d6, d7);

//the time when the sensor outputs a low impulse
long unsigned int lowIn;

//the amount of milliseconds the sensor has to be low before we assume all motion has stopped
int pause = 5000;
boolean lockLow = true;
boolean takeLowTime;
int pirPin = 9; //the digital pin connected to the PIR sensor's output
int buzzerPin = 8;

/**-------------------------------------------------------------------------------------
 * Initialization for Weather Station + AC Unit
 */
int sensorPin = A0; // Adjustment for what Analog Pin, currently A0
int tempC, tempF;
int AC = 10;
int get_temperature(int pin) {
  int temperature = analogRead(pin);
  float voltage = temperature * 5.0;
  voltage = voltage / 1024.0;
  return ((voltage - 0.5) * 100);
}
int celsius_to_fahrenheit(int temp) {
  return (temp * 9.0 / 5.0) + 32.0;
}

/**-------------------------------------------------------------------------------------
 * Initialization Automated Night Light
 */
int ledPinRED = A2;
int prPin = A1; // Photoresistor Pin

/**-------------------------------------------------------------------------------------
 * Initialization for the BT Indoor Light
 */
SoftwareSerial BT(3,1); //TX, RX of the BT respectively connect to RX, TX of Arduino
//(Can't use pin 0 instead of 3 as Arduino can't receive it for some reason).
String state;// string to store incoming message from bluetooth

/**-------------------------------------------------------------------------------------
 * Initialization for Push Fire Alert
 */
//Talkie voice;
int buttonPin = 2;
int buttonState = 0; // variable for reading the pushbutton status
const unsigned char sample[] PROGMEM = {
126, 128, 128, 125, 128, 128, 126, 128, 127, 127, 128, 128,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 127,
128, 127, 127, 127, 127, 127, 128, 128, 127, 127, 127, 127,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 129,
131, 124, 127, 133, 127, 124, 129, 128, 126, 128, 129, 127,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 128,
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127, 127, 127, 127, 127, 128, 128, 128,
};

//////////////////////////////////////////////////////////////////////////////////////////////////////////////////////////////////
void setup(){
/**
 * Set up for Intruder Detection System
 */
Serial.begin(9600);
pinMode(pirPin, INPUT);
digitalWrite(pirPin, LOW);
pinMode(buzzerPin, OUTPUT);
lcd.begin(16,2); // Initialize the LCD with column and row
lcd.clear();

/**-------------------------------------------------------------------------------------
 * Set up for Weather Station + AC Unit
 */
pinMode(AC, OUTPUT);
 
/**-------------------------------------------------------------------------------------
 * Set up for Automated Night Light
 */
pinMode(ledPinRED, OUTPUT);
pinMode(prPin, INPUT);

/**-------------------------------------------------------------------------------------
 * Set up for BT Indoor Light
 */
BT.begin(9600);// bluetooth serial communication will happen on pin 10 and 11
pinMode(A3, OUTPUT); // LED connected to 13th pin

/**-------------------------------------------------------------------------------------
 * Set Up for Fire Alert System
 */
pinMode(buttonPin, INPUT);
// pinMode(11, OUTPUT);
// digitalWrite(11, HIGH); //Enable Amplified PROP shield
}

//////////////////////////////////////////////////////////////////////////////////////////////////////////////////////////////////
void loop(){
  String ret = "";
  /**-------------------------------------------------------------------------------------
   * Loop for BT Indoor Light
   */
  while (BT.available()){ //Check if there is an available byte to read
    delay(10); //Delay added to make thing stable
    char c = BT.read(); //Conduct a serial read
    state += c; //build the string- either "On" or "off"
  }
  
  if (state.length() > 0) {
    if(state == "On") // Check
    {
      digitalWrite(A3, HIGH);
    }
    else if(state == "Off")
    {
      digitalWrite(A3, LOW);
    }
    state ="";
  }
  
  /**-------------------------------------------------------------------------------------
   * Loop for Weather Station + AC Unit
   */
  tempC = get_temperature(sensorPin);
  tempF = celsius_to_fahrenheit(tempC);
  lcd.setCursor(0,0);
  lcd.print("Temp: ");
  lcd.setCursor(6,0);
  lcd.print(tempF); lcd.print((char)223); lcd.print("F");
  lcd.setCursor(12,0);
  lcd.print(tempC); lcd.print((char)223); lcd.print("C");
  
  //This is a condition to turn the AC on.
  if(tempF >= 67)
  {
    digitalWrite(AC, HIGH);
  }
  else if(tempF < 67)
  {
    digitalWrite(AC, LOW);
  }
  ret += tempC;
  ret += "|";
  ret += tempF;
  ret += "|";
  delay(200);
  
  /**-------------------------------------------------------------------------------------
   * Loop for Intruder System
   */
  lcd.setCursor(0,1);
  if(digitalRead(pirPin) == HIGH){
    tone(buzzerPin, 150);
    if(lockLow){
      //makes sure we wait for a transition to LOW before any further output is made:
      lockLow = false; // reset lock low
      lcd.print("Thief! Call 911!");
      ret += "Intruder detected at ";
      ret += millis()/1000;
      ret += " sec";
      delay(100);
    }
    takeLowTime = true;
  }
  
  if(digitalRead(pirPin) == LOW){
    noTone(buzzerPin);
    if(takeLowTime){
      lowIn = millis(); //save the time of the transition from high to LOW
      takeLowTime = false; //make sure this is only done at the start of a LOW phase
    }
    
    //if the sensor is low for more than the given pause,
    //we assume that no more motion is going to happen
    if(!lockLow && millis() - lowIn > pause){
      //makes sure this block of code is only executed again after
      //a new motion sequence has been detected
      lockLow = true;
      lcd.print("----------------");
      ret += "Intruder stopped at ";
      ret += (millis() - pause)/1000;
      ret += " sec";
      delay(100);
    }
  }
  
  Serial.println(ret);
  ret = "";
  
  /**-------------------------------------------------------------------------------------
   * Loop for Automated Night Light
   */
  int prStatus = analogRead(prPin);
  if (prStatus >= 300){
    digitalWrite(ledPinRED, HIGH);
  }
  else{
    digitalWrite(ledPinRED, LOW);
  }
  
  /**-------------------------------------------------------------------------------------
   * Loop for Fire Alert System.
   */
   buttonState = digitalRead(buttonPin);
   if (buttonState == HIGH) {
   voice.say(sp2_DANGER);
   voice.say(sp2_DANGER);
   voice.say(sp2_RED);
   voice.say(sp2_ALERT);
   voice.say(sp2_FIRE);
   voice.say(sp2_FIRE);
   voice.say(sp2_FIRE);
  }
  
  buttonState = digitalRead(buttonPin);
  if (buttonState == HIGH) {
    startPlayback(sample, sizeof(sample));
    delay(2000);
  }
}
